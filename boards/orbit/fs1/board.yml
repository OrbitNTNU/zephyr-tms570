## boards/orbit/fs1/board.yml
```yaml
board:
  name: fs1
  full_name: Orbit FS1
  vendor: orbit
  socs:
  - name: tms570ls1224
```

## drivers/can/Kconfig.tms570
```kconfig
config CAN_TMS570
    bool "TI TMS570 CAN Controller"
    default y
    depends on DT_HAS_TI_TMS570_CAN_ENABLED

if CAN_TMS570

config CAN_TMS570_TX_MAX
    int "Maximum TX objects"
    default 32
    range 1 64
    help
        Adjust this to adjust proporition of CAN message objects allotted to
        TX (and RX). Total RX message objects is computed as
        64 - CONFIG_CAN_TMS570_TX_MAX.

endif
```

## drivers/gpio/Kconfig.tms570
```kconfig
config GPIO_TMS570
    bool "TI TMS570 GPIO Controller"
    default y
    depends on DT_HAS_TI_TMS570_GPIO_ENABLED && GPIO

if GPIO_TMS570

config GPIO_TMS570_CTRL_INIT_PRIORITY
    int
    default 39

endif
```

## drivers/interrupt_controller/Kconfig.tms570
```kconfig
config TMS570_INTC
    bool
    default y
    depends on DT_HAS_TI_TMS570_INTC_ENABLED
```

## drivers/spi/Kconfig.tms570
```kconfig
config SPI_TMS570
    bool "TI TMS570 SPI Controller"
    default y
    depends on DT_HAS_TI_TMS570_SPI_ENABLED

if SPI_TMS570

config SPI_TMS570_DMA
    bool "Use DMA for TMS570 SPI"
    default y

endif
```

## dts/bindings/can/ti,tms570-can.yaml
```yaml
description: TI TMS570 CAN Controller
compatible: ti,tms570-can
include: can-controller.yaml
```

## dts/bindings/dma/ti,tms570-dma.yaml
```yaml
description: "DMA controller for TMS570"
compatible: "ti,tms570-dma"

include: [dma-controller.yaml, base.yaml]

properties:
  reg:
    required: true

  interrupts:
    required: true

  "#dma-cells":
    const: 2

dma-cells:
  - channel
  - request
```

## dts/bindings/gpio/ti,tms570-gpio-port.yaml
```yaml
compatible: ti,tms570-gpio-port
description: Texas Instruments TMS570 GPIO Port
include: [gpio-controller.yaml, base.yaml]

properties:
  reg:
    required: true

  interrupt-capable:
    type: boolean

  "#gpio-cells":
    const: 2

gpio-cells:
  - pin
  - flags
```

## dts/bindings/gpio/ti,tms570-gpio.yaml
```yaml
compatible: ti,tms570-gpio
description: TI TMS570 GPIO Controller
include: base.yaml

properties:
  reg:
    required: true
```

## dts/bindings/interrupt_control/ti,tms570-intc.yaml
```yaml
description: "Interrupt controller for TMS570"
compatible: "ti,tms570-intc"

include: [base.yaml, interrupt-controller.yaml]

properties:
  reg:
    required: true

interrupt-cells:
  - irq
  - priority
```

## dts/bindings/serial/ti,tms570-serial.yaml
```yaml
description: TMS570 UART Driver

compatible: "ti,tms570-uart"

include: [uart-controller.yaml, pinctrl-device.yaml]

properties:
  reg:
    required: true

  clocks:
    required: true
```

## dts/bindings/spi/ti,tms570-spi.yaml
```yaml
compatible: ti,tms570-spi
description: TI TMS570 SPI Controller
include: [spi-controller.yaml, pinctrl-device.yaml]

properties:
  dma-request-rx:
    type: int
    description: DMA Request RX 

  dma-request-tx:
    type: int
    description: DMA Request TX 

  dma-channel-rx:
    type: int
    description: DMA Channel RX 

  dma-channel-tx:
    type: int
    description: DMA Channel TX 
```

## dts/bindings/spi/tms570-spi.yaml
```yaml
description: TI TMS570 I2C

compatible: "tms570,spi"

include: [spi-controller.yaml, pinctrl-device.yaml, base.yaml]

properties:
  reg:
    required: true

  interrupts:
    required: true
```

## dts/bindings/timer/ti,tms570-timer.yaml
```yaml
description: "Timer for TMS570"
compatible: "ti,tms570-timer"

include: base.yaml

properties:
  reg:
    required: true

  clocks:
    required: false

  interrupts:
    required: true
```
