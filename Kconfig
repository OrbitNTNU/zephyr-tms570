## boards/orbit/fs1/fs1_defconfig
```kconfig
CONFIG_SYS_CLOCK_HW_CYCLES_PER_SEC=32000000
CONFIG_PINCTRL=y
CONFIG_CLOCK_CONTROL=y
CONFIG_DMA=y
```

## cmake/toolchain/be-arm-none-eabi/Kconfig
```kconfig
# GNU ARM Embedded Toolchain

# Copyright (c) 2020 Linaro Limited.
# SPDX-License-Identifier: Apache-2.0

config TOOLCHAIN_BE_ARM_NONE_EABI
	def_bool y
	select HAS_NEWLIB_LIBC_NANO
	select NEWLIB_LIBC_SUPPORTED

config TOOLCHAIN_BE_ARM_NONE_EABI_SUPPORTS_GNU_EXTENSIONS
	def_bool y
	select TOOLCHAIN_SUPPORTS_GNU_EXTENSIONS
```

## drivers/Kconfig
```kconfig
rsource "interrupt_controller/Kconfig"
rsource "pinctrl/Kconfig"
rsource "clock_control/Kconfig"
rsource "timer/Kconfig"
rsource "serial/Kconfig"
rsource "i2c/Kconfig"
rsource "dma/Kconfig"
```

## drivers/clock_control/Kconfig.tms570
```kconfig
config CLOCK_CONTROL_TMS570
    bool
    default y
    depends on DT_HAS_TMS570_CLOCK_ENABLED

config CLOCK_PLL_TMS570
    bool
    default y
    depends on DT_HAS_TMS570_PLL_ENABLED && CLOCK_CONTROL_TMS570
```

## drivers/dma/Kconfig.tms570
```kconfig
config DMA_TMS570
    bool "Using TMS570 DMA Driver"
    default y
    depends on DT_HAS_TMS570_DMA_ENABLED
```

## drivers/i2c/Kconfig.tms570
```kconfig
config I2C_TMS570
	bool "TMS570LS1224 I2C driver"
	default y
    select I2C_BITBANG
	depends on DT_HAS_TMS570_I2C_ENABLED
	help
	  Enable I2C support on TMS570LS1224
```

## drivers/pinctrl/Kconfig.tms570
```kconfig
config PINCTRL_TMS570
	bool "TMS570 pinctrl driver"
	default y
	depends on DT_HAS_TMS570_PINCTRL_ENABLED
	help
	  Enable the TMS570 pinctrl driver
```

## drivers/serial/Kconfig
```kconfig
config UART_TMS570
    bool
    default y
    select SERIAL_HAS_DRIVER
    select SERIAL_SUPPORT_INTERRUPT
    select SERIAL_SUPPORT_ASYNC
    depends on DT_HAS_TMS570_UART_ENABLED && SERIAL
```

## drivers/timer/Kconfig.tms570
```kconfig
config TMS570_TIMER
    bool 
    select TIMER_HAS_64BIT_CYCLE_COUNTER
    default y if DT_HAS_TMS570_TIMER_ENABLED
```

## dts/bindings/clock_control/tms570-clock.yaml
```yaml
description: TMS570 clock controller

compatible: "tms570,clock"

include: [clock-controller.yaml, base.yaml]

properties:
  reg:
    required: true

  "#clock-cells":
    const: 1

  clock-frequency:
    type: int
    required: true

clock-cells:
  - clk_id
```

## dts/bindings/clock_control/tms570-pll.yaml
```yaml
description: "PLL support for TMS570" 
compatible: "tms570,pll"

include: base.yaml

properties:
  nr:
    description: "Prescale divider NR"
    type: int
    required: true

  nf:
    description: "Multiplier NF"
    type: int
    required: true

  od:
    description: "Postscale divider OD"
    type: int
    required: true

  r:
    description: "Postscale divider R"
    type: int
    required: true
```

## dts/bindings/dma/tms570-dma.yaml
```yaml
description: "DMA controller for TMS570"
compatible: "tms570,dma"

include: [dma-controller.yaml, base.yaml]

properties:
  reg:
    required: true

  interrupts:
    required: true

  "#dma-cells":
    const: 2

dma-cells:
  - dma-channels
  - dma-requests
```

## dts/bindings/i2c/tms570-i2c.yaml
```yaml
description: TI TMS570 I2C

compatible: "tms570,i2c"

include: [i2c-controller.yaml, pinctrl-device.yaml, base.yaml]

properties:
  reg:
    required: true

  interrupts:
    required: true

  module-clock-frequency:
    required: true
    type: int
```

## dts/bindings/interrupt_control/tms570-intc.yaml
```yaml
description: "Interrupt controller for TMS570"
compatible: "tms570,intc"

include: base.yaml

properties:
  reg:
    required: true

interrupt-cells:
  - irq
  - priority
```

## dts/bindings/pinctrl/tms570-pinctrl.yaml
```yaml
description: "Pinctrl for TMS570"
compatible: "tms570,pinctrl"

include: base.yaml

properties:
  reg:
    required: true

child-binding:
  properties:
    pinmux:
      required: true
      type: int
      description: |
        MMIO register and pin bit number
```

## dts/bindings/serial/tms570,serial.yaml
```yaml
description: TMS570 UART Driver

compatible: "tms570,uart"

include: [uart-controller.yaml, pinctrl-device.yaml]

properties:
  reg:
    required: true

  clocks:
    required: true

  dma-request-rx:
    type: int
    description: DMA Request RX 

  dma-request-tx:
    type: int
    description: DMA Request TX 

  dma-channel-rx:
    type: int
    description: DMA Channel RX 

  dma-channel-tx:
    type: int
    description: DMA Channel TX 
```

## dts/bindings/timer/tms570,timer.yaml
```yaml
description: "Timer for TMS570"
compatible: "tms570,timer"

include: base.yaml

properties:
  reg:
    required: true

  clocks:
    required: false

  interrupts:
    required: true
```

## soc/hercules/Kconfig.soc
```kconfig
config SOC_FAMILY_HERCULES
    bool

config SOC_FAMILY
    default "hercules" if SOC_FAMILY_HERCULES

rsource "*/Kconfig.soc"
```

## soc/hercules/tms570/Kconfig
```kconfig
config SOC_SERIES_TMS570
    bool
    select ARM
    select CPU_CORTEX_R4
    select CPU_HAS_DCLS
    select CPU_HAS_FPU
    select FPU
    select ARM_CUSTOM_INTERRUPT_CONTROLLER
    select SYS_CLOCK_EXISTS
    select BIG_ENDIAN
    select PLATFORM_SPECIFIC_INIT
    select VFP_DP_D16
    select XIP

config SOC_PART_NUMBER
    string
    default "tms570ls1224" if SOC_TMS570LS1224
```

## soc/hercules/tms570/Kconfig.defconfig
```kconfig
if SOC_TMS570LS1224

config SYS_CLOCK_HW_CYCLES_PER_SEC
    default 16000000

config NUM_IRQS
    int
    default 127

config PINCTRL
    default y
    select PINCTRL_TMS570

config FLASH_SIZE
    default 1310719

config FLASH_BASE_ADDRESS
    default 0x0

config VIM
	bool "TI Vectored Interrupt Manager"
	default y
	depends on DT_HAS_TI_VIM_ENABLED

endif # SOC_SERIES_TMS570
```

## soc/ti/hercules/Kconfig.defconfig
```kconfig
if SOC_FAMILY_HERCULES

rsource "*/Kconfig.defconfig"

endif # SOC_FAMILY_HERCULES
```
